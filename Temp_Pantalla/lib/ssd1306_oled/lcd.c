/**
 * OLED 128x32 SS1306 
 * I2C interface
*/
#include "lcd.h"


static uint8_t buffer[LCD_HEIGHT*LCD_WIDTH/8];
static const uint16_t font16x26 [] = {
0x0000,0x0000,0x0000,0x0000,0x0000,0x0000,0x0000,0x0000,0x0000,0x0000,0x0000,0x0000,0x0000,0x0000,0x0000,0x0000,0x0000,0x0000,0x0000,0x0000,0x0000,0x0000,0x0000,0x0000,0x0000,0x0000, // Ascii = [ ]
0x03E0,0x03E0,0x03E0,0x03E0,0x03E0,0x03E0,0x03E0,0x03E0,0x03C0,0x03C0,0x01C0,0x01C0,0x01C0,0x01C0,0x01C0,0x0000,0x0000,0x0000,0x03E0,0x03E0,0x03E0,0x0000,0x0000,0x0000,0x0000,0x0000, // Ascii = [!]
0x1E3C,0x1E3C,0x1E3C,0x1E3C,0x1E3C,0x1E3C,0x1E3C,0x0000,0x0000,0x0000,0x0000,0x0000,0x0000,0x0000,0x0000,0x0000,0x0000,0x0000,0x0000,0x0000,0x0000,0x0000,0x0000,0x0000,0x0000,0x0000, // Ascii = ["]
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0x0000,0x0000,0x0000,0x0000,0x0000,0x0000,0x0000,0x0000,0x0000,0x0000,0x0000,0x3F07,0x7FC7,0x73E7,0xF1FF,0xF07E,0x0000,0x0000,0x0000,0x0000,0x0000,0x0000,0x0000,0x0000,0x0000,0x0000, // Ascii = [~]
};

void display_onresume(i2c_lcd *dev, enum mode_on bit_e) {
    uint8_t cmd = 0x52;
    cmd = (cmd<<1)| (uint8_t)bit_e;
    i2c_write_8bits(dev, dev->slave_addr, CONT_BIT | CMD_MODE | CONTROL_REG, cmd);
}
void display_off(i2c_lcd *dev) {
    uint8_t cmd = 0xAE;
    i2c_write_8bits(dev, dev->slave_addr, CONT_BIT | CMD_MODE | CONTROL_REG, cmd);
}
void display_on(i2c_lcd *dev) {
    uint8_t cmd = 0xAF;
    i2c_write_8bits(dev, dev->slave_addr, CONT_BIT | CMD_MODE | CONTROL_REG, cmd);
}
void set_display_mode(i2c_lcd *dev, uint8_t m){
    i2c_write_8bits(dev, dev->slave_addr, CONT_BIT | CMD_MODE | CONTROL_REG, m);
}
void set_mult_ratio(i2c_lcd *dev, uint8_t r_m){
    i2c_write_8bits(dev, dev->slave_addr, CONT_BIT | CMD_MODE | CONTROL_REG, 0xA8);
    i2c_write_8bits(dev, dev->slave_addr, CONT_BIT | CMD_MODE | CONTROL_REG, r_m);
}
void set_clock_divider(i2c_lcd *dev, uint8_t c_d){
    i2c_write_8bits(dev, dev->slave_addr, CONT_BIT | CMD_MODE | CONTROL_REG, c_d);
}
void set_display_offset(i2c_lcd *dev, uint8_t o_s){
    i2c_write_8bits(dev, dev->slave_addr, CONT_BIT | CMD_MODE | CONTROL_REG, 0xD3);
    i2c_write_8bits(dev, dev->slave_addr, CONT_BIT | CMD_MODE | CONTROL_REG, o_s);
}
void set_start_line(i2c_lcd *dev, uint8_t s_l){
    i2c_write_8bits(dev, dev->slave_addr, CONT_BIT | CMD_MODE | CONTROL_REG, s_l);
}
void set_segm_re_map(i2c_lcd *dev, uint8_t s_r){
    i2c_write_8bits(dev, dev->slave_addr, CONT_BIT | CMD_MODE | CONTROL_REG, s_r);
}
void set_COM_output_direction(i2c_lcd *dev, uint8_t o_d){
    i2c_write_8bits(dev, dev->slave_addr, CONT_BIT | CMD_MODE | CONTROL_REG, o_d);
}
void set_COM_pins_config(i2c_lcd *dev, uint8_t pins){
    i2c_write_8bits(dev, dev->slave_addr, CONT_BIT | CMD_MODE | CONTROL_REG, 0xDA);
    i2c_write_8bits(dev, dev->slave_addr, CONT_BIT | CMD_MODE | CONTROL_REG, pins);
}
void set_contrast(i2c_lcd *dev, uint8_t c){
    i2c_write_8bits(dev, dev->slave_addr, CONT_BIT | CMD_MODE | CONTROL_REG, 0x81);
    i2c_write_8bits(dev, dev->slave_addr, CONT_BIT | CMD_MODE | CONTROL_REG, c);
}
void set_osc_frecuency(i2c_lcd *dev, uint8_t o_f){
    i2c_write_8bits(dev, dev->slave_addr, CONT_BIT | CMD_MODE | CONTROL_REG, 0xD5);
    i2c_write_8bits(dev, dev->slave_addr, CONT_BIT | CMD_MODE | CONTROL_REG, o_f);
}
void set_charge_pump_regulator(i2c_lcd *dev, uint8_t c_p){
    i2c_write_8bits(dev, dev->slave_addr, CONT_BIT | CMD_MODE | CONTROL_REG, 0x8D);
    i2c_write_8bits(dev, dev->slave_addr, CONT_BIT | CMD_MODE | CONTROL_REG, c_p);
}
void set_memory_mode(i2c_lcd *dev, uint8_t m_m){
    i2c_write_8bits(dev, dev->slave_addr, CONT_BIT | CMD_MODE | CONTROL_REG, 0x20);
    i2c_write_8bits(dev, dev->slave_addr, CONT_BIT | CMD_MODE | CONTROL_REG, m_m);
}

void lcd_draw_pixel(i2c_lcd *dev,uint8_t x, uint8_t y, enum background color_e){
     // Draw in the right color
    if(color_e == WHITE) {
        buffer[x + (y / 8) * LCD_WIDTH] |= 1 << (y % 8);
    } else { 
        buffer[x + (y / 8) * LCD_WIDTH] &= ~(1 << (y % 8));
    }
    //lcd_update_screen(dev);
}
void lcd_write_char(i2c_lcd *dev,char ch, enum background color_e, cursor position){
    uint8_t x=0,y=0;
    uint16_t c;
    while(y<FONT_HEIGHT){
        c = font16x26[(ch-32)*FONT_HEIGHT+y];
        while(x<FONT_WIDTH){
            if((c<<x)&0x8000){ 
                lcd_draw_pixel(dev, position.x + x, position.y + y, WHITE);
            }else{
                lcd_draw_pixel(dev, position.x + x, position.y + y, BLACK);
            }
            x++;
        }
        x=0;
        y++;
    }
}
void lcd_update_screen(i2c_lcd *dev){
    uint8_t i;
    for (i = 0; i < LCD_HEIGHT/8; i++){
        i2c_write_8bits(dev,dev->slave_addr, CONT_BIT | CMD_MODE | CONTROL_REG, 0xB0+i);  /**< End */
        i2c_write_8bits(dev,dev->slave_addr, CONT_BIT | CMD_MODE | CONTROL_REG, 0x00);  /**< End */
        i2c_write_8bits(dev,dev->slave_addr, CONT_BIT | CMD_MODE | CONTROL_REG, 0x10);  /**< End */
        i2c_write_mult(dev,dev->slave_addr, CONT_BIT | DATA_MODE | CONTROL_REG, &buffer[LCD_WIDTH*i], LCD_WIDTH);  /**< End */
    }
}
void lcd_fill(enum background bgd){
    uint16_t i;
    uint8_t value;
    if (bgd == LINES){
            value = 0xF0;
    }else if (bgd == WHITE){
            value = 0xFF;
    }else{
        value =0x00;
    }
    for ( i = 0; i < (LCD_WIDTH*LCD_HEIGHT/8); i++){
        buffer[i] = value;
    }
}
void lcd_send_word(i2c_lcd *dev, char *str, uint8_t size){
    uint8_t incr;
    uint8_t i;
    cursor position;
    position.x = 5;
    position.y = 5;
    incr =  LCD_WIDTH/size - 10;

    if (incr<FONT_WIDTH)
        return 0; /**< Too many chars */

    for (i = 0; i < size; i++){
        lcd_write_char(dev, str[i], WHITE, position);
        position.x += (FONT_WIDTH + (incr-FONT_WIDTH));
    }
    

}
